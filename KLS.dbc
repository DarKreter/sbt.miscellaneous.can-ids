BO_ 2364612101 KLS_DATA_1: 8 XXX
 SG_ Speed : 0|16@1+ (1.0, 0) [0|6000] "rpm" Vector_XXX
 SG_ Current : 16|16@1+ (0.1, 0) [0|400] "A" Vector_XXX
 SG_ Voltage : 32|16@1+ (0.1, 0) [0|180] "V" Vector_XXX
 SG_ Error0 : 48|1@1+ (1, 0) [0|1] "" Vector_XXX
 SG_ Error1 : 49|1@1+ (1, 0) [0|1] "" Vector_XXX
 SG_ Error2 : 50|1@1+ (1, 0) [0|1] "" Vector_XXX
 SG_ Error3 : 51|1@1+ (1, 0) [0|1] "" Vector_XXX
 SG_ Error4 : 52|1@1+ (1, 0) [0|1] "" Vector_XXX
 SG_ Error5 : 53|1@1+ (1, 0) [0|1] "" Vector_XXX
 SG_ Error6 : 54|1@1+ (1, 0) [0|1] "" Vector_XXX
 SG_ Error7 : 55|1@1+ (1, 0) [0|1] "" Vector_XXX
 SG_ Error8 : 56|1@1+ (1, 0) [0|1] "" Vector_XXX
 SG_ Error9 : 57|1@1+ (1, 0) [0|1] "" Vector_XXX
 SG_ Error10 : 58|1@1+ (1, 0) [0|1] "" Vector_XXX
 SG_ Error11 : 59|1@1+ (1, 0) [0|1] "" Vector_XXX
 SG_ Error12 : 60|1@1+ (1, 0) [0|1] "" Vector_XXX
 SG_ Error13 : 61|1@1+ (1, 0) [0|1] "" Vector_XXX
 SG_ Error14 : 62|1@1+ (1, 0) [0|1] "" Vector_XXX
 SG_ Error15 : 63|1@1+ (1, 0) [0|1] "" Vector_XXX

BO_ 2364612357 KLS_DATA_2: 8 XXX
 SG_ Throttle : 0|8@1+ (-0.390625, 100) [-100|100] "%" Vector_XXX
 SG_ ControllerTemp : 8|8@1+ (1.0, -40) [-50|400] "*C" Vector_XXX
 SG_ MotorTemp : 16|8@1+ (1.0, -30) [-50|400] "*C" Vector_XXX
 SG_ Reserved1 : 24|8@1+ (1.0, 0) [0|255] "" Vector_XXX
 SG_ StatusOfCommand : 32|2@1+ (1.0, 0) [0|4] "" Vector_XXX
 SG_ StatusOfFeedback : 34|2@1+ (1.0, 0) [0|4] "" Vector_XXX
 SG_ Reserved2 : 36|4@1+ (1.0, 0) [0|15] "" Vector_XXX
 SG_ HallA : 40|1@1+ (1.0, 0) [0|1] "" Vector_XXX
 SG_ HallB : 41|1@1+ (1.0, 0) [0|1] "" Vector_XXX
 SG_ HallC : 42|1@1+ (1.0, 0) [0|1] "" Vector_XXX
 SG_ BrakeSwitch12V : 43|1@1+ (1.0, 0) [0|1] "" Vector_XXX
 SG_ BackwardSwitch : 44|1@1+ (1.0, 0) [0|1] "" Vector_XXX
 SG_ ForwardSwitch : 45|1@1+ (1.0, 0) [0|1] "" Vector_XXX
 SG_ FootSwitch : 46|1@1+ (1.0, 0) [0|1] "" Vector_XXX
 SG_ BoostSwitch : 47|1@1+ (1.0, 0) [0|1] "" Vector_XXX
 SG_ Reserved3 : 48|8@1+ (1.0, 0) [0|255] "" Vector_XXX
 SG_ Reserved4 : 56|8@1+ (1.0, 0) [0|255] "" Vector_XXX
